## techpack/datarmnet-ext/wlan/Kconfig
```kconfig
#
# RMNET_WLAN driver
#

config RMNET_WLAN
    tristate "Rmnet WLAN support"
    default m
    depends on RMNET_CORE
    help
        WLAN processing module for RmNet driver
```

## techpack/wlan/Kconfig
```kconfig
config CNSS_OUT_OF_TREE
    bool "CNSS out of tree"
    default n
    help
      This option is to enable CNSS compilation out of it's usual path.
      If unsure, say n.

source "techpack/wlan/platform/cnss2/Kconfig"

source "techpack/wlan/platform/cnss_genl/Kconfig"

source "techpack/wlan/platform/cnss_prealloc/Kconfig"

source "techpack/wlan/platform/cnss_utils/Kconfig"

source "techpack/wlan/platform/icnss2/Kconfig"

source "techpack/wlan/qcacld-3.0/Kconfig"
```
